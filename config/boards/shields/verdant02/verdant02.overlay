/*
 * Copyright (c) 2026 The ZMK Contributors
 * SPDX-License-Identifier: MIT
 *
 * Board-specific overlay: promicro_nrf52840 (SuperMini NRF52840).
 *
 * - #include verdant02.dtsi for the shield-agnostic kscan + matrix
 *   skeleton (chosen nodes, col2row direction, map of 54 RC entries).
 * - Append row-gpios (8 inputs, PULL_DOWN + ACTIVE_HIGH) and
 *   col-gpios (7 outputs, ACTIVE_HIGH) matching the SuperMini /
 *   ProMicro NRF52840 pinout provided by the user:
 *
 *   ROWS (QMK -> silk -> nRF pin):
 *     R0 PD2  -> D0      P0.08
 *     R1 PB4  -> D8      P1.04
 *     R2 PF7  -> A0/D18  P1.15
 *     R3 PD7  -> D6      P1.00
 *     R4 PD4  -> D4      P0.22
 *     R5 PE6  -> D7      P0.11
 *     R6 PB3  -> D14     P1.11
 *     R7 PB1  -> D15     P1.13
 *
 *   COLS:
 *     C0 PC6  -> D5      P0.24
 *     C1 PF6  -> A1/D19  P0.02
 *     C2 PB5  -> D9      P1.06
 *     C3 PD3  -> D1      P0.06
 *     C4 PB6  -> D10     P0.09
 *     C5 PF4  -> A3/D21  P0.31
 *     C6 PF5  -> A2/D20  P0.29
 *
 * GPIO direction (INPUT vs OUTPUT) is set by the zmk,kscan-gpio-matrix
 * driver automatically; NEVER include GPIO_INPUT or GPIO_OUTPUT flags
 * in the DT specifier cells, because flags cell only carries ACTIVE_x,
 * PULL_x and similar modifiers.
 */

#include "verdant02.dtsi"

&kscan0 {
    row-gpios
        = <&gpio0  8 (GPIO_PULL_DOWN | GPIO_ACTIVE_HIGH)>
        , <&gpio1  4 (GPIO_PULL_DOWN | GPIO_ACTIVE_HIGH)>
        , <&gpio1 15 (GPIO_PULL_DOWN | GPIO_ACTIVE_HIGH)>
        , <&gpio1  0 (GPIO_PULL_DOWN | GPIO_ACTIVE_HIGH)>
        , <&gpio0 22 (GPIO_PULL_DOWN | GPIO_ACTIVE_HIGH)>
        , <&gpio0 11 (GPIO_PULL_DOWN | GPIO_ACTIVE_HIGH)>
        , <&gpio1 11 (GPIO_PULL_DOWN | GPIO_ACTIVE_HIGH)>
        , <&gpio1 13 (GPIO_PULL_DOWN | GPIO_ACTIVE_HIGH)>
        ;

    col-gpios
        = <&gpio0 24 (GPIO_ACTIVE_HIGH)>
        , <&gpio0  2 (GPIO_ACTIVE_HIGH)>
        , <&gpio1  6 (GPIO_ACTIVE_HIGH)>
        , <&gpio0  6 (GPIO_ACTIVE_HIGH)>
        , <&gpio0  9 (GPIO_ACTIVE_HIGH)>
        , <&gpio0 31 (GPIO_ACTIVE_HIGH)>
        , <&gpio0 29 (GPIO_ACTIVE_HIGH)>
        ;
};
